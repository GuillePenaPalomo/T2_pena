## main/Kconfig.projbuild
```kconfig
# Las opciones declaradas en un Kconfig.projbuild aparecen en el nivel superior
# del menu de configuracion, junto a las de ESP-IDF, y no dentro del submenu de
# configuracion de componentes. Se convierten en macros CONFIG_... disponibles
# desde el codigo.
#
# Los pines no estan aqui: estan en main/pines.h, que es donde se declaran los
# pines del proyecto. Las prioridades, en main/tareas.h.

menu "SEyTR - Taller 2"

    config SEYTR_CARGA_RAFAGA_MS
        int "Rafaga de calculo de cada tarea de carga, en milisegundos"
        range 2 500
        default 20
        help
            Tiempo de calculo de cada ciclo de las tareas `carga_a` y
            `carga_b`, fijadas al nucleo 0. Varios ticks, para que el
            planificador llegue a turnarlas.

    config SEYTR_CARGA_ESPERA_MS
        int "Espera bloqueada de cada tarea de carga, en milisegundos"
        range 3 1000
        default 27
        help
            Tiempo que cada tarea de carga pasa bloqueada en cada ciclo. Tiene
            que ser mayor que la rafaga, para que la tarea inactiva del nucleo
            llegue a ejecutarse. El ciclo, rafaga mas espera, no debe ser
            divisor del periodo del sensor ni multiplo del periodo de los
            temporizadores: con 20 + 27 = 47 ms no lo es de ninguno.

    config SEYTR_SENSOR_PERIODO_MS
        int "Periodo de muestreo del sensor, en milisegundos"
        range 10 10000
        default 1000
        help
            Periodo de la tarea del sensor. La temperatura, la presion y la
            humedad de una sala cambian en segundos o minutos, y el sensor
            convierte en menos de 10 ms: 1 s sigue de sobra esos cambios y deja
            el procesador libre el 99 % del tiempo. Con el tick a 1000 Hz, el
            periodo se expresa en ticks enteros.

    config SEYTR_SENSOR_INTERVALOS
        int "Intervalos de cada resumen de periodo y jitter del sensor"
        range 5 500
        default 50
        help
            Numero fijo de intervalos entre activaciones con que se calcula
            cada resumen. Con 50 y un periodo de 1 s, un resumen tarda 50 s.

    config SEYTR_LED_FRECUENCIA_HZ
        int "Frecuencia de la salida modulada del LED, en hercios"
        range 100 40000
        default 5000
        help
            Muy por encima de la frecuencia a la que el ojo deja de distinguir
            el parpadeo, unos 100 Hz, y tambien del efecto estroboscopico al
            mover el LED. Frecuencia por 2^resolucion no puede pasar del reloj
            del temporizador, 80 MHz: a 5 kHz caben 16 000 pasos, 13 bits.

    config SEYTR_LED_RESOLUCION_BITS
        int "Resolucion de la salida modulada del LED, en bits"
        range 1 14
        default 13
        help
            2^13 = 8192 niveles de brillo: el maximo que cabe a 5 kHz, y de
            sobra para que una transicion se vea continua. Con 14 bits el 100 %
            se escribe 2^14 - 1.

    config SEYTR_LED_MEDIO_PORCENTAJE
        int "Brillo del modo medio, en tanto por ciento"
        range 1 99
        default 25
        help
            El ojo no ve el brillo en proporcion al ciclo de trabajo: con un
            25 % el LED ya se ve claramente a media luz.

    config SEYTR_LED_TRANSICION_MS
        int "Duracion pedida de cada subida o bajada del modo transicion, en milisegundos"
        range 100 10000
        default 1500

    config SEYTR_GUARDA_MS
        int "Tiempo de guarda del antirrebote del pulsador, en milisegundos"
        range 1 1000
        default 200
        help
            Tras una pulsacion aceptada, los flancos que lleguen antes se
            descartan como rebote. Es la ventana justificada en el Taller 1.

    config SEYTR_CONFIRMACION_MS
        int "Espera antes de confirmar el nivel del pulsador, en milisegundos"
        range 1 999
        default 20
        help
            Tras un flanco aceptado, la tarea espera este tiempo y comprueba que
            el pin sigue a nivel de pulsado. Algo mayor que el rebote y menor
            que el tiempo de guarda.

endmenu
```
